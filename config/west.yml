## config/west.yml
```yaml
manifest:
  remotes:
    - name: zmkfirmware
      url-base: https://github.com/zmkfirmware
    - name: petejohanson
      url-base: https://github.com/petejohanson/zmk.git
  projects:
    - name: zmk
      remote: petejohanson
      revision: shields/splitkb-aurora-lily58
      import: app/west.yml
  self:
    path: config
```
